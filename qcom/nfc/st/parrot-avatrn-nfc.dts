/dts-v1/;
/plugin/;

#include "parrot-avatrn-nfc-overlay.dtsi"

/ {
	model = "avatrn";
	compatible = "qcom,parrot", "qcom,parrot-qrd", "qcom,qrd", "moto,avatrn";
	qcom,msm-id = <613 0x10000>;
	qcom,board-id = <0x41 0xA100>, <0x41 0xA300>;
};
